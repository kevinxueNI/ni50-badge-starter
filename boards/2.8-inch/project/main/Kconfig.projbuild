## boards/2.8-inch/project/main/Kconfig.projbuild
```kconfig
# Kconfig.projbuild — cleaned for ESP-IDF v6.0.1 compatibility
# LVGL and BT symbols are now managed by their respective components.
# Values are set in sdkconfig.defaults instead.

menu "Badge Page Selection"

    config PAGE_CARD
        bool "Page: Card (名片主页)"
        default y
        help
            Always-on main card page with avatar, name, department.

    config PAGE_CALENDAR
        bool "Page: Calendar (日历)"
        default y
        help
            NI Milestone Calendar with highlighted special dates.

    config PAGE_MILESTONE
        bool "Page: Milestone (NI历史里程碑)"
        default y
        help
            NI history timeline with animated data flow.

    config PAGE_HISTORY
        bool "Page: History (卡通故事)"
        default y
        help
            Full-screen cartoon image page.

    config PAGE_DAQ
        bool "Page: DAQ Dashboard (仪表盘)"
        default n
        help
            Real-time dashboard showing RSSI, temperature, memory, uptime.

    config PAGE_GALLERY
        bool "Page: NI Gallery (图片画廊)"
        default y
        help
            NI Gallery with NI Logo history and LabVIEW 1.0 screenshots.
            Enters independent screen for image browsing.

    config PAGE_IMPACT
        bool "Page: Impact Radar (全球影响力)"
        default y
        help
            Static 5-axis radar chart showing global impact metrics.

    config PAGE_IDENTITY
        bool "Page: Identity (数字身份/QR)"
        default y
        help
            QR code + orbit animation digital identity page.
            Warning: uses extra PSRAM for QR bitmap conversion.

    config PAGE_GAME
        bool "Page: Memory Game (记忆翻牌)"
        default n
        help
            NI product memory card matching game.

    config PAGE_2048
        bool "Page: 2048 Game"
        default n
        help
            Classic 2048 sliding puzzle game.

    config PAGE_PLAYER
        bool "Page: Image Player (相册播放)"
        default n
        help
            SD card image slideshow player.

    config PAGE_MATCH3
        bool "Page: Match-3 (恩了个恩)"
        default n
        help
            NI-themed match-3 puzzle game. Lazy-loaded on first visit.

    config PAGE_CONFIG
        bool "Page: Config (WiFi配置)"
        default y
        help
            WiFi AP config page with HTTP server for profile/time settings.

endmenu
```

## boards/2.8-inch/project/sdkconfig.defaults
```kconfig
CONFIG_IDF_TARGET="esp32s3"

CONFIG_SPIRAM=y
CONFIG_SPIRAM_MODE_OCT=y
CONFIG_SPIRAM_SPEED_80M=y

CONFIG_LV_USE_USER_DATA=y
CONFIG_LV_USE_CHART=y
CONFIG_LV_USE_PERF_MONITOR=y
CONFIG_LV_MEM_SIZE_KILOBYTES=128
CONFIG_LV_USE_DEMO_WIDGETS=y
CONFIG_LV_DEMO_WIDGETS_SLIDESHOW=y
CONFIG_LV_USE_DEMO_KEYPAD_AND_ENCODER=y
CONFIG_LV_USE_DEMO_BENCHMARK=y
CONFIG_LV_USE_DEMO_STRESS=y
CONFIG_LV_USE_DEMO_MUSIC=y
CONFIG_LV_FONT_MONTSERRAT_10=y
CONFIG_LV_FONT_MONTSERRAT_12=y
CONFIG_LV_FONT_MONTSERRAT_14=y
CONFIG_LV_FONT_MONTSERRAT_16=y
CONFIG_LV_FONT_MONTSERRAT_18=y
CONFIG_LV_FONT_MONTSERRAT_22=y
CONFIG_LV_FONT_MONTSERRAT_28=y

CONFIG_LV_USE_FS_POSIX=y
CONFIG_LV_FS_POSIX_LETTER=80
CONFIG_LV_USE_PNG=y
CONFIG_LV_USE_BMP=y
CONFIG_LV_USE_SJPG=y
CONFIG_LV_USE_QRCODE=y

CONFIG_BT_ENABLED=y
CONFIG_BT_BLE_50_FEATURES_SUPPORTED=y
CONFIG_BT_BLE_42_FEATURES_SUPPORTED=y

CONFIG_I2C_SUPPRESS_DEPRECATE_WARN=y

CONFIG_ESP32S3_DATA_CACHE_LINE_64B=y
CONFIG_ESP32S3_DATA_CACHE_LINE_SIZE=64

CONFIG_FATFS_LFN_STACK=y
CONFIG_FATFS_MAX_LFN=255
CONFIG_FATFS_API_ENCODING_ANSI_OEM=y

CONFIG_ESPTOOLPY_FLASHSIZE_16MB=y
CONFIG_PARTITION_TABLE_CUSTOM=y

CONFIG_ESP_DEFAULT_CPU_FREQ_MHZ_240=y

# Badge Page Selection
CONFIG_PAGE_CARD=y
CONFIG_PAGE_CALENDAR=y
CONFIG_PAGE_MILESTONE=y
CONFIG_PAGE_HISTORY=y
CONFIG_PAGE_DAQ=n
CONFIG_PAGE_GALLERY=y
CONFIG_PAGE_IMPACT=n
CONFIG_PAGE_IDENTITY=n
CONFIG_PAGE_GAME=n
CONFIG_PAGE_2048=n
CONFIG_PAGE_PLAYER=n
CONFIG_PAGE_MATCH3=n
CONFIG_PAGE_CONFIG=y



#CONFIG_FREERTOS_HZ=1000

#CONFIG_ESPTOOLPY_FLASHMODE_QIO=y
#CONFIG_ESPTOOLPY_FLASHFREQ_120M=y
#CONFIG_SPIRAM_MODE_OCT=y

#CONFIG_IDF_EXPERIMENTAL_FEATURES=y
#CONFIG_SPIRAM_SPEED_120M=y

#CONFIG_SPIRAM_FETCH_INSTRUCTIONS=y
#CONFIG_SPIRAM_RODATA=y
#CONFIG_ESP32S3_DATA_CACHE_LINE_64B=y
#CONFIG_COMPILER_OPTIMIZATION_PERF=y
```

## boards/4-inch/project/sdkconfig.defaults
```kconfig
# ESP-IDF v6.0.1 + Waveshare ESP32-S3-Touch-LCD-4 (480x480 RGB, 16MB Flash, 8MB PSRAM)
# Minimal sdkconfig for Badge project

# Flash
CONFIG_ESPTOOLPY_FLASHMODE_QIO=y
CONFIG_ESPTOOLPY_FLASHSIZE_16MB=y
CONFIG_PARTITION_TABLE_CUSTOM=y

# Performance
CONFIG_COMPILER_OPTIMIZATION_PERF=y
CONFIG_ESP_DEFAULT_CPU_FREQ_MHZ_240=y
CONFIG_FREERTOS_HZ=1000

# PSRAM (OPI 80MHz)
CONFIG_SPIRAM=y
CONFIG_SPIRAM_MODE_OCT=y
CONFIG_SPIRAM_FETCH_INSTRUCTIONS=y
CONFIG_SPIRAM_RODATA=y
CONFIG_SPIRAM_SPEED_80M=y
CONFIG_ESP32S3_DATA_CACHE_LINE_64B=y

# LVGL 8.4 essentials
CONFIG_LV_ATTRIBUTE_FAST_MEM_USE_IRAM=y
CONFIG_LV_MEM_SIZE_KILOBYTES=48

# Fonts needed for Badge UI (trim unused ones to save flash)
CONFIG_LV_FONT_MONTSERRAT_14=y
CONFIG_LV_FONT_MONTSERRAT_16=y
CONFIG_LV_FONT_MONTSERRAT_18=y
CONFIG_LV_FONT_MONTSERRAT_20=y
CONFIG_LV_FONT_MONTSERRAT_24=y
CONFIG_LV_FONT_MONTSERRAT_28=y
CONFIG_LV_FONT_MONTSERRAT_32=y
CONFIG_LV_FONT_MONTSERRAT_48=y
CONFIG_LV_FONT_UNSCII_8=y
CONFIG_LV_FONT_UNSCII_16=y
```
